const uint16_t louiev2[] = {
    // 'image, 32x39px

    0x0000,
    0x0000,
    0x0000,
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    0x0000,

};
#include <RTClib.h>
#include <Adafruit_Protomatter.h>
#include <Adafruit_NeoPixel.h>
// Feather M4 + RGB Matrix FeatherWing
// Use FeatherWing pinout
uint32_t alarmFreq = 2000;
uint8_t alarmHour = 26;
uint8_t alarmMin = 63;
uint8_t alarmSec = 63;
uint8_t rgbPins[] = {6, 5, 9, 11, 10, 12};
uint8_t addrPins[] = {A5, A4, A3, A2};
uint8_t clockPin = 13;
uint8_t latchPin = 0;
uint8_t oePin = 1;
#define BLACK 0x0000
#define BLUE 0x001F
#define RED 0xF800
#define GREEN 0x07E0
#define CYAN 0x07FF
#define MAGENTA 0xF81F
#define YELLOW 0xFFE0
#define WHITE 0xFFFF
bool alarmStopArm = false;
RTC_DS3231 rtc;
const DateTime currTime = {2023, 5, 17, 12, 53, 30};
char daysOfTheWeek[7][12] = {"SUN", "MON", "TUE", "WED", "THR", "FRI", "SAT"};
char monthsOfTheYear[13][12] = {"empty", "JAN", "FEB", "MAR", "APR", "MAY", "JUN", "JUL", "AUG", "SEP", "OCT", "NOV", "DEC"};
// Create a 32-pixel tall, 64 pixel wide matrix with the defined pins
Adafruit_Protomatter matrix(
    64, 5, 1, rgbPins, 4, addrPins, clockPin, latchPin, oePin, true);
void setup(void)
{

  pinMode(14, INPUT_PULLDOWN);
  // Initialize matrix...
  ProtomatterStatus status = matrix.begin();
  if (status != PROTOMATTER_OK)
  {
    // DO NOT CONTINUE if matrix setup encountered an error.
    for (;;)
      ;
  }
  // AFTER DRAWING, A show() CALL IS REQUIRED TO UPDATE THE MATRIX!
  matrix.setRotation(1);
  matrix.show(); // Copy data to matrix buffers
  rtc.begin();
  attachInterrupt(digitalPinToInterrupt(14), alarmStop, RISING);
  rtc.adjust(currTime);

  // Serial.begin(9600);
  delay(1000);
  // Serial.println('fuck yea');
}
// LOOP - RUNS REPEATEDLY AFTER SETUP --------------------------------------
char str[] = "WOULD BE FUN TO CURSE ON THIS";
int strLength = 30;
void loop(void)
{
  matrix.fillScreen(BLACK);
  drawLouie();
  timePrint(CYAN, YELLOW, RED, WHITE);
  matrix.show();
  // Since there's nothing more to be drawn, this loop() function just
  // shows the approximate refresh rate of the matrix at current settings.
}
void timePrint(uint16_t mainColor, uint16_t dayColor, uint16_t monthColor, uint16_t dateColor)
{
  DateTime now = rtc.now();
  if (now.hour() == alarmHour)
  {
    if (now.minute() == alarmMin)
    {
      if (now.second() == alarmSec)
      {
        soundAlarm();
      }
    }
  }
  uint8_t hour = now.hour();
  uint8_t min = now.minute();
  matrix.setCursor(1, 0);
  matrix.setTextSize(1);
  matrix.setTextColor(mainColor);
  if (hour > 12)
  {
    hour = hour - 12;
  }
  if (hour < 10)
  {
    matrix.print("0");
    if (hour == 0)
    {
      hour = 1;
    }
  }
  matrix.print(hour, DEC);
  matrix.print(":");
  if (min < 10)
  {
    matrix.print("0");
  }
  matrix.print(min, DEC);
  matrix.println();
  matrix.setCursor(1, 11);
  matrix.setTextSize(1);
  matrix.setTextColor(dayColor);
  matrix.print(" ");
  matrix.print(daysOfTheWeek[now.dayOfTheWeek()]);
  matrix.println();
  matrix.setCursor(1, 20);
  matrix.setTextColor(monthColor);
  matrix.print(monthsOfTheYear[now.month()]);
  matrix.setTextColor(dateColor);
  if (now.day() < 10)
  {
    matrix.print(" ");
  }
  matrix.print(now.day());
  matrix.setTextSize(1);
  matrix.setCursor(0, 0);
}
void drawLouie()
{
  matrix.drawRGBBitmap(0, 30, louiev2, 32, 39);
}
void alarmStop()
{
  // noTone(4);
  if (alarmStopArm)
  {
    alarmStopArm = false;
  }
  noTone(4);
}
void soundAlarm()
{
  // tone(4, 2000);
  alarmStopArm = true;
  while (alarmStopArm)
  {
    // tone(4,alarmFreq);
    // tone(4, 2000);
    matrixFlash(RED);
    delay(500);
    matrixFlash(WHITE);
    delay(500);
    // noTone(4);
    matrixFlash(RED);
    delay(500);
    matrixFlash(WHITE);
    delay(200);
  }
}
void matrixFlash(uint16_t shade)
{
  matrix.setTextColor(CYAN);
  matrix.setCursor(3, 3);
  matrix.setTextSize(2);
  matrix.print(rtc.now().hour());
  matrix.setCursor(16, 3);
  matrix.print(":");
  matrix.setCursor(3, 19);
  matrix.print(rtc.now().minute());
  matrix.drawRect(0, 0, 32, 64, shade);
  matrix.drawRect(1, 1, 30, 62, shade);
  matrix.show();
}
